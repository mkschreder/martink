## adc/KConfig
```kconfig
menu "Analog-to-digital (ADC) drivers"
	config ADC
		bool "ADC Support"
	config ATMEGA_ADC
		depends on ADC
		bool "ATMega ADC support"
endmenu
		
```

## apps/KConfig
```kconfig
choice 
	prompt "Main Application Target"

	config ARDUINO_PWM_BLINK_THREAD
		depends on CPU_ATMEGA328P
		bool "Arduino threaded PWM and BLINK example"
	config ARDUINO_EXTERNAL_RTC_EEPROM
		depends on CPU_ATMEGA328P
		bool "Arduino DS3231 RTC/EEPROM example"
	config ARDUINO_APP_RANGEFINDER
		depends on CPU_ATMEGA328P
		bool "Arduino 6-channel rangefinder"

endchoice

comment "Utility applications"
config APP_print_hello
	depends on ARCH_LINUX
	bool "Print Hello APP"

config APP_imx23_ssd1306
	depends on ARCH_LINUX
	bool "ssd1306 example on imx233 board"

config APP_test 
	depends on ARCH_LINUX
	bool "simple test app"

config APP_RTOS_TEST_dis
	bool "simple rtos test"
```

## arch/KConfig
```kconfig
menu "Target CPU"
	choice 
		prompt "CPU Target"
		
		config ARCH_AVR
			bool "Atmel AVR"
		
		config ARCH_ARM
			bool "ARM"
		
		config ARCH_XTENSA
			bool "Xtensa" 

		config ARCH_LINUX
			bool "Linux"
			help 
				Compile for linux
			
	endchoice 
		
	source arch/avr/KConfig
	source arch/arm/KConfig
	source arch/xtensa/KConfig
	source arch/linux/KConfig
endmenu
```

## arch/arm/KConfig
```kconfig
config ARCH_ARM_CM3
	bool

choice
	depends on ARCH_ARM
	prompt "ARM Model" 

	config CPU_STM32F10x
		select ARCH_ARM_CM3
		bool "STM32F10x"
	
	config CPU_STM32F30x
		select ARCH_ARM_CM3
		bool "STM32F30x"

	config CPU_STM32F37x
		select ARCH_ARM_CM3
		bool "STM32F37x"

	config CPU_STM32L1xx
		select ARCH_ARM_CM3
		bool "STM32L1xx"

	config CPU_AT91SAM3
		bool "AT91SAM3"
endchoice 
```

## arch/arm/stm32/KConfig
```kconfig
choice
	depends on CPU_STM32
	prompt "STM32 Model" 
	default CPU_STM32F10X
	
	config CPU_STM32F10X
		bool "STM32F10X"
endchoice 
```

## arch/avr/m328p/KConfig
```kconfig
choice 
	prompt "AVR Model" 
	default ATMEGA328P
	
	config ATMEGA328P
		depends on AVR
		select HAVE_UART
		select HAVE_UART0
		select HAVE_I2C
		select HAVE_TWI
		select HAVE_TWI0
		select HAVE_SPI
		select HAVE_SPI0
		select HAVE_TIMER0
		select HAVE_TIMER1
		select HAVE_TIMER2
		bool "AVR ATMega328P"
		
	config ATMEGA88
		depends on AVR
		bool "AVR ATMega88"
endchoice 
```

## arch/avr/mega/KConfig
```kconfig
choice 
	prompt "AVR Model" 
	depends on CPU_AVR_MEGA

	config CPU_ATMEGA328P
		depends on CPU_AVR
		bool "AVR ATMega328P"

	config CPU_ATMEGA103
		depends on CPU_AVR
		bool "AVR ATMega103"
		
	config CPU_ATMEGA88
		depends on CPU_AVR
		bool "AVR ATMega88"

	config CPU_ATMEGA128
		depends on CPU_AVR
		bool "AVR ATMega128"

	config CPU_ATMEGA168
		depends on CPU_AVR
		bool "AVR ATMega168"

	config CPU_ATMEGA2560
		depends on CPU_AVR
		bool "AVR ATMega2560"

	config CPU_ATMEGA644
		depends on CPU_AVR
		bool "AVR ATMega644"

	config CPU_ATMEGA48
		depends on CPU_AVR
		bool "AVR ATMega48"
endchoice 

menu "Configure ATMega328P driver"
	depends on CPU_ATMEGA328P
	comment "ATmega328P general options"
	
	config TIMESTAMP_COUNTER
		default y
		bool "Enable timestamp subsystem (timer1 configured as cpu clock counter)"
		help
			Uses timer1 for microsecond time measurement tasks. This is
			very useful for many other features so leave this enabled
			(although you will not be able to use timer1 for anything else)
			
	config ADC_MODE_AUTOMATIC
		default n
		bool "Enable continuous automatic adc measurement on all channels"
		help
			Uses 16 bytes more memory but monitors all adc channels
			continously using ADC interrupt. These values can then be read
			immediately using adc0_read_cached(chan) instead of having to
			wait for each conversion to complete.

	config GPIO_PIN_STATES
		select TIMESTAMP_COUNTER
		default y
		bool "Enable GPIO pin states"
		help
			Enables gpio_get_status() and state change recording for GPIO
			pins with timestamp for when the change occured. For this
			PCINT handlers are used. This lets you use gpio_get_status()
			to read last gpioio event and time for last leading and
			trailing edge with microsecond precision. This in turn lets
			you easily measure pulse widths on gpio pins and read various
			sensors that report values using pulse width signal, without
			having to implement all this functionality yourself. The
			drawback: it currently uses ~200 bytes of memory for state
			information.

	comment "UART Config ---"
	
	config BUFFERED_UART
		default y
		bool "Use buffered uart"
		help
			Enables interrupt driven buffered uart using circular buffer.
			Enables fast writes without having to wait for the data to be
			sent. All data is instead sent in the background.

	config UART0_TX_BUF_SIZE
		depends on BUFFERED_UART
		default 32
		int "Uart TX buffer size (power of 2!)"
		help
			Set the size of the outgoing data buffer in bytes. If you
			enter value that is not power of two, the value will be
			increased so that it becomes power of 2 in code (for fast
			modulo operation)

	config UART0_RX_BUF_SIZE
		depends on BUFFERED_UART
		default 32
		int "Uart RX buffer size (power of 2!)"
		help
			Set the size of the incoming buffer for received data.

	config UART0_NAME
		depends on HAVE_UART0
		default "uart0"
		string "UART0 device name"
	config UART1_NAME
		depends on HAVE_UART1
		default "uart1"
		string "UART1 device name"
	config UART2_NAME
		depends on HAVE_UART2
		default "uart2"
		string "UART2 device name"

	comment "SPI config ---"
	config SPI0_NAME
		depends on HAVE_SPI0
		default "spi0"
		string "SPI0 device name"
	config SPI1_NAME
		depends on HAVE_SPI1
		default "spi1"
		string "SPI1 device name"
	config SPI2_NAME
		depends on HAVE_SPI2
		default "spi2"
		string "SPI2 device name"

	comment "I2C/TWI config ---"
	
	config TWI0_NAME
		depends on HAVE_TWI0
		default "twi0"
		string "TWI0 device name"
	config TWI1_NAME
		depends on HAVE_TWI1
		default "twi1"
		string "TWI1 device name"
endmenu
```

## arch/xtensa/KConfig
```kconfig
choice 
	prompt "CPU Model"
	depends on XTENSA 
	
	config XTENSA_ESP8266
		bool "ESP8266"
endchoice

config XTENSA_APP_BLINKY
	depends on XTENSA
	bool "Blink led on boot"
```

## boards/KConfig
```kconfig
choice
	prompt "Target Board"
	default BOARD_MULTIWII

	config BOARD_MULTIWII
		depends on CPU_ATMEGA328P
		select MPU6050
		select HMC5883L
		select BMP085
		bool "Multiwii V2.5 Flight Controller"

	config BOARD_MINIMOSD
		depends on CPU_ATMEGA328P
		select MAX7456
		bool "MiminOSD ATMega328P board"

	config BOARD_IMX233
		depends on CPU_NATIVE
		bool "IMX233 Board"
	
	config BOARD_PROMINI
		depends on CPU_ATMEGA328P
		bool "Arduino Pro-Mini module"
	
	config BOARD_STM32F103
		depends on CPU_STM32F10X
		bool "STM32F103C6 dev board"
	
	config BOARD_ARDUINO_DUE
		depends on CPU_AT91SAM3
		bool "Arduino Due SAM3"
		
	config BOARD_ARDURADIO
		depends on CPU_ATMEGA328P
		bool "Fortmax custom arduino radio board"
		
	config BOARD_GENERIC_LINUX
		depends on CPU_NATIVE
		bool "Compile ELF for running on linux"
endchoice
```

## bus/KConfig
```kconfig
config BUS_I2C
	bool
config BUS_SPI
	bool 

config LINUX_I2C
	depends on ARCH_LINUX
	select BUS_I2C
	bool "Linux i2c bridge driver"
config LINUX_SPI
	depends on ARCH_LINUX
	select BUS_SPI
	bool "Linux SPI bridge driver"
```

## crypto/KConfig
```kconfig
menu "Cryptographic support"
	config CRYPTO
		bool "Enable crypto functions"
	config CRYPTO_AES
		depends on CRYPTO
		bool "AES encryption support"
endmenu
```

## disp/KConfig
```kconfig
menu "Display support"
	config ILI9340
		bool "ILI9340 serial display driver"
	
	config LCDPAR
		bool "Generic parallel LCD driver"
		
	config LEDMATRIX88
		bool "Led matrix driver"
		
	config SSD1306
		bool "SSD1306 OLED display driver"

	config SEVSEG
		bool "Seven segment display driver"
		
endmenu
```

## gpio/KConfig
```kconfig
menu "GPIO Support"
	config GPIO_SUPPORT
		bool "Enable GPIO support"

	config ATMEGA_GPIO
		depends on GPIO_SUPPORT && CPU_ATMEGA328P
		bool "ATMega328p GPIO Support"

	config STM32_GPIO
		depends on GPIO_SUPPORT && CPU_STM32
		bool "STM32 GPIO Support"
endmenu
```

## i2c/KConfig
```kconfig
menu "I2C Support"
	config I2C
		bool "Enable I2C support"
	config ATMEGA_I2C
		depends on I2C && ARCH_AVR
		bool "ATMega I2C Support"
endmenu
```

## io/KConfig
```kconfig
menu "IO logic support"
	config L74HC165
		depends on HAVE_SPI
		bool "L74HC165 parallel to serial shift register"
		
	config L74HC4051
		depends on HAVE_SPI
		bool "L74HC4051 multiplexer support"
		
	config L74HC595
		depends on HAVE_SPI
		bool "L74HC595 serial to parallel shift register"
		
	config PCF8574
		bool "PCF8574 I2C io expander"
endmenu
```

## kernel/KConfig
```kconfig
menu "Kernel Configuration"
	config HAVE_THREADING
		bool

	source kernel/freertos/KConfig
endmenu
```

## kernel/freertos/KConfig
```kconfig
config FREERTOS
	select HAVE_THREADING
	bool "FreeRTOS scheduler support"
	help 
		Enables realtime sheduler support and allows you to build a multithreaded application. 
```

## memory/KConfig
```kconfig
menu "External Memory"
	config BLOCK
		bool "Enable block device support"
	config ATMEGA_EEPROM
		depends on BLOCK && ARCH_AVR
		bool "ATMega EEPROM support"
	config AT24
		depends on I2C
		bool "AT24 EEPROM driver"
endmenu
```

## motors/KConfig
```kconfig
menu "Motor driver support"
	config BLDCSENSORED
		bool "Sensored BLDC motor support"
	config BLDCSENSORLESS
		bool "Sensorless BLDC motor support"
	config DCMOTOR
		bool "DC motor support"
	config DCPWM
		bool "DC motor pwm support"
	config DCSOFTPWM
		bool "DC software pwm support"
	config PWM
		bool "Generic pwm support"
	config PWMMCD4017
		bool "MCD4017 PWM support"
	config STEPPER02
		bool "Stepper motor support"
endmenu
		
```
