## net/KConfig
```kconfig
menu "Network support"
	config ENC28J60
		bool "ENC28J60 SPI LAN Network Chip"

	config DHCP
		bool "DHCP protocol support"
		
	config DNS 
		bool "DNS protocol support"

	config RFNET
		depends on NRF24L01 && AES
		bool "RFNET radio protocol support"

	config TCPIP
		depends on ENC28J60
		bool "TCPIP/UDP/ICMP protocol support"
endmenu
```

## pwm/KConfig
```kconfig
menu "PWM Support"
	config PWM_SUPPORT
		bool "Enable PWM support"
	config ATMEGA_PWM
		depends on PWM_SUPPORT && CPU_ATMEGA328P
		bool "ATMega328P PWM driver"
endmenu
```

## radio/KConfig
```kconfig
menu "Radio modem support"
	config NRF24L01
		bool "NRF24L01 SPI module"
endmenu
```

## rfid/KConfig
```kconfig
menu "RFID readers support"
	config MFRC522
		bool "MFRC522 13mhz RFID reader support"
endmenu
```

## rtc/KConfig
```kconfig
menu "Realtime Clock Support"
	config RTC 
		bool "Enable RTC drivers"
	config DS3231
		depends on RTC && I2C
		bool "DS3231 I2C RTC"
endmenu
```

## sensors/KConfig
```kconfig
menu "Sensor drivers"
	config ACS712
		bool "ACS712 current sensor"
	config ADXL345
		bool "ADXL345 accelerometer support"
	config AMT1001
		bool "AMT1001 resistive temperature and humidity sensor"
	config BH1750
		bool "BH1750 digital light sensor"
	config BMP085
		bool "BMP085 pressure sensor"
	config DHT
		bool "DHTxx series humidity and temperature sensor"
	config DS18B20
		bool "DS18B20 one wire digital termometer sensor"
	config FS300A
		bool "FS300A water flow sensor"
	config HCSR04
		bool "HCSR04 sonic distance sensor"
	config HMC5883L
		bool "HMC5883L I2C compass sensor"
	config IMU10DOF01
		bool "IMU10DOF01 10 deg of freedom module"
	config L3G4200D
		bool "L3G4200D I2C gyroscope sensor"
	config MMA7455
		bool "MMA7455 digital accelerometer"
	config MPU6050
		bool "MPU6050 I2C acc/gyro sensor"
	config TEMT6000
		bool "TEMT6000 ambient light sensor"
	config TSL235
		bool "TSL235 light to frequency sensor"
endmenu
```

## serial/KConfig
```kconfig
menu "Serial Device"
	config UART
		bool "UART Support"

	config ATMEGA_UART
		depends on UART && CPU_ATMEGA328P
		bool "ATMegaXXX UART Driver"
endmenu
```

## spi/KConfig
```kconfig
menu "SPI Support"
	config SPI
		bool "Enable SPI support"
	config ATMEGA_SPI
		depends on SPI && CPU_ATMEGA328P
		bool "ATMega328P SPI Support"
endmenu
```
